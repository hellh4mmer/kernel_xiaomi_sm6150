## arch/arm64/configs/toco_defconfig
```kconfig
CONFIG_TEXTSEARCH=y
CONFIG_TEXTSEARCH_KMP=y
CONFIG_TEXTSEARCH_BM=y
CONFIG_TEXTSEARCH_FSM=y
CONFIG_ASSOCIATIVE_ARRAY=y
CONFIG_HAS_IOMEM=y
CONFIG_HAS_IOPORT_MAP=y
CONFIG_HAS_DMA=y
# CONFIG_SGL_ALLOC is not set
# CONFIG_DMA_NOOP_OPS is not set
# CONFIG_DMA_VIRT_OPS is not set
CONFIG_CPU_RMAP=y
CONFIG_DQL=y
CONFIG_GLOB=y
# CONFIG_GLOB_SELFTEST is not set
CONFIG_NLATTR=y
CONFIG_CLZ_TAB=y
# CONFIG_CORDIC is not set
# CONFIG_DDR is not set
# CONFIG_IRQ_POLL is not set
CONFIG_MPILIB=y
CONFIG_LIBFDT=y
CONFIG_OID_REGISTRY=y
# CONFIG_SG_SPLIT is not set
CONFIG_SG_POOL=y
CONFIG_ARCH_HAS_SG_CHAIN=y
CONFIG_SBITMAP=y
# CONFIG_STRING_SELFTEST is not set

#
# Xiaomi configuration options
#
CONFIG_MACH_XIAOMI=y
CONFIG_MACH_XIAOMI_SDMMAGPIE=y

#
# Xiaomi board selection
#
# CONFIG_MACH_XIAOMI_COURBET is not set
# CONFIG_MACH_XIAOMI_DAVINCI is not set
# CONFIG_MACH_XIAOMI_PHOENIX is not set
# CONFIG_MACH_XIAOMI_SWEET is not set
CONFIG_MACH_XIAOMI_TOCO=y
# CONFIG_MACH_XIAOMI_TUCANA is not set
```
